## keyboards/zmk/corneish-zen/config/west.yml
```yaml
manifest:
  remotes:
    - name: zmkfirmware
      url-base: https://github.com/zmkfirmware
  projects:
    - name: zmk
      remote: zmkfirmware
      revision: 4.1-branch
      import: app/west.yml
  self:
    path: config
```
